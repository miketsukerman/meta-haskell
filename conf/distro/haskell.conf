## conf/distro/haskell.conf
```bitbake
# Distro Layer configuration
# include and overwrite default poky distro
include conf/distro/poky.conf
DISTRO = "haskell"
DISTRO_NAME = "haskell-Linux"
DISTRO_VERSION = "1.0"
DISTRO_CODENAME = "Guacamole"
SDK_VENDOR = "-haskell-sdk"
SDK_VERSION="${DISTRO_VERSION}"
MAINTAINER = "info@haskell.com"

TARGET_VENDOR = "-haskell"

# Override these in poky based distros
haskell_DEFAULT_DISTRO_FEATURES = "bluetooth ext2 usbgadget usbhost wifi xattr nfs zeroconf 3g"
haskell_DEFAULT_EXTRA_RDEPENDS = "packagegroup-core-boot"
haskell_DEFAULT_EXTRA_RRECOMMENDS = "kernel-module-af-packet"

DISTRO_EXTRA_RDEPENDS += " ${haskell_DEFAULT_EXTRA_RDEPENDS}"
DISTRO_EXTRA_RRECOMMENDS += " ${MYDISTO_DEFAULT_EXTRA_RRECOMMENDS}"

DISTRO_FEATURES ?= "${haskell_DEFAULT_DISTRO_FEATURES} ${DISTRO_FEATURES_LIBC} "

PACKAGE_CLASSES = "package_rpm"

# Use systemd as init manager
DISTRO_FEATURES_append = " systemd"
DISTRO_FEATURES_BACKFILL_CONSIDERED += "sysvinit"
VIRTUAL-RUNTIME_init_manager = "systemd"
VIRTUAL-RUNTIME_initscripts = "systemd-compat-units"
```

## conf/layer.conf
```bitbake
#
#   Copyright (C) 2019 Michael Tsukerman
#   SPDX-License-Identifier: MIT
#

# We have a conf and classes directory, append to BBPATH
BBPATH .= ":${LAYERDIR}"

# We have a recipes directory, add to BBFILES
BBFILES += " \
    ${LAYERDIR}/recipes-*/*/*.bb       \
    ${LAYERDIR}/recipes-*/*/*.bbappend \
"

BBFILE_COLLECTIONS += "haskell-layer"
BBFILE_PATTERN_haskell-layer := "^${LAYERDIR}/"

# Setting this variable allows you to prioritize a layer against other
# layers that contain the same recipe. A larger value for the 
# BBFILE_PRIORITY variable results in a higher precedence. 
BBFILE_PRIORITY_haskell-layer = "7"

LAYERSERIES_COMPAT_haskell-layer = "thud warrior"
```
